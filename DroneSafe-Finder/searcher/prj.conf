## CMakeLists.txt
```
# Copyright (c) 2024 Nordic Semiconductor ASA
# SPDX-License-Identifier: LicenseRef-Nordic-5-Clause
cmake_minimum_required(VERSION 3.20.0)
list(APPEND CONF_FILE
  ${CMAKE_CURRENT_SOURCE_DIR}/../common/base.conf
  ${CMAKE_CURRENT_SOURCE_DIR}/prj.conf)
find_package(Zephyr REQUIRED HINTS $ENV{ZEPHYR_BASE})
project(nu54_secure_recovery_searcher)
target_include_directories(app PRIVATE ../common src tests)
target_sources(app PRIVATE
  src/main.c
  src/walk_range_filter.c
  tests/walk_range_filter_test.c
  ../common/secure_pair.c
  ../common/usb_console.c
  ../common/nu54_peripherals.c)
```

## Kconfig
```
# SPDX-License-Identifier: Apache-2.0
mainmenu "NU54V authenticated recovery searcher"
source "Kconfig.zephyr"
```

## prj.conf
```kconfig
# Copyright (c) 2024 Nordic Semiconductor ASA
# SPDX-License-Identifier: LicenseRef-Nordic-5-Clause
# Shared security, storage, UART, I2C and Bluetooth buffers are in common/base.conf.
CONFIG_BT_CENTRAL=y
CONFIG_BT_AUTO_PHY_CENTRAL_1M=y
CONFIG_BT_USER_PHY_UPDATE=y
CONFIG_BT_GATT_CLIENT=y
CONFIG_BT_GATT_DM=y
CONFIG_BT_GATT_DYNAMIC_DB=y
CONFIG_BT_RAS_RREQ=y
CONFIG_BT_RAS_MODE_3_SUPPORTED=n
CONFIG_BT_RAS_MAX_ANTENNA_PATHS=1
CONFIG_BT_CS_DE_MAX_NUM_ANTENNA_PATHS=1
CONFIG_BT_CTLR_SDC_CS_MAX_ANTENNA_PATHS=1
CONFIG_BT_CTLR_SDC_CS_NUM_ANTENNAS=1
CONFIG_BT_CTLR_SDC_CS_STEP_MODE3=n
CONFIG_BT_CTLR_SDC_CS_ROLE_INITIATOR_ONLY=y
CONFIG_BT_CTLR_CHANNEL_SOUNDING_TEST=n
CONFIG_BT_TRANSMIT_POWER_CONTROL=y
CONFIG_BT_CS_DE=y
CONFIG_BT_CS_DE_512_NFFT=y
CONFIG_BT_DEVICE_NAME="NU54 Secure Searcher"
CONFIG_MAIN_STACK_SIZE=6144
CONFIG_SYSTEM_WORKQUEUE_STACK_SIZE=4096
CONFIG_BT_RX_STACK_SIZE=4096
# Local CS and remote RAS assembly callbacks must share the BT RX work queue.
CONFIG_BT_RECV_WORKQ_BT=y
```

## app.overlay
```dts
/* SSD1306 128x64 uses the NU54 QWIIC bus P1.02/P1.03. Its direct framebuffer
 * driver addresses only 0x3c or 0x3d; no scan/configuration of PMIC 0x6a.
 * Requires manufacturer target nrf54l15dk/nrf54l15/cpuapp/nu54dk.
 */
&i2c22 {
    status = "okay";
    clock-frequency = <100000>;
};

&nfct { status = "disabled"; };
```

## src/walk_range_filter.c
```c
/* SPDX-License-Identifier: Apache-2.0 */
#include "walk_range_filter.h"
#include <math.h>
#include <string.h>

void walk_range_reset(struct walk_range_filter *filter)
{
    memset(filter, 0, sizeof(*filter));
}

static float median3(float a, float b, float c)
{
    float t;
    if (a > b) { t = a; a = b; b = t; }
    if (b > c) { t = b; b = c; c = t; }
    if (a > b) { t = a; a = b; b = t; }
    return b;
}

enum walk_range_state walk_range_update(struct walk_range_filter *filter,
        float raw_metres, int64_t sample_ms, int64_t now_ms,
        struct walk_range_output *output)
{
    if (!filter || !output || !isfinite(raw_metres) || raw_metres < 0.0f ||
        raw_metres > 9999.0f || sample_ms < 0 || now_ms < sample_ms ||
        now_ms - sample_ms > WALK_RANGE_MAX_AGE_MS ||
        (filter->seen_sample && sample_ms <= filter->last_sample_ms) ||
        (filter->have_output && now_ms < filter->output_wall_ms))
        return WALK_RANGE_INVALID;

    if (filter->seen_sample &&
        sample_ms - filter->last_sample_ms > WALK_RANGE_WINDOW_GAP_MS) {
        filter->count = filter->next = 0;
    }
    filter->last_sample_ms = sample_ms;
    filter->seen_sample = true;
    filter->samples[filter->next] = raw_metres;
    filter->next = (filter->next + 1U) % 3U;
    if (filter->count < 3U) ++filter->count;
    if (filter->count < 3U) return WALK_RANGE_WARMING;

    const float target = median3(filter->samples[0], filter->samples[1], filter->samples[2]);
    float value = target, limit = 0.0f;
    bool limited = false;
    if (filter->have_output) {
        int64_t dt = sample_ms - filter->output_sample_ms;
        const int64_t wall_dt = now_ms - filter->output_wall_ms;
        if (wall_dt < dt) dt = wall_dt;
        /* A larger budget can never be used in our [0,9999] domain. Cap before
         * float conversion, not by resetting the anchor after a long outage. */
        if (dt > 5000000) dt = 5000000;
        limit = WALK_RANGE_SPEED_MPS * ((float)dt / 1000.0f);
        const float delta = target - filter->metres;
        if (delta > limit) { value = filter->metres + limit; limited = true; }
        else if (delta < -limit) { value = filter->metres - limit; limited = true; }
    }
    filter->metres = value;
    filter->have_output = true;
    filter->output_sample_ms = sample_ms;
    filter->output_wall_ms = now_ms;
    *output = (struct walk_range_output) {
        .metres = value, .median_metres = target,
        .limit_metres = limit, .limited = limited,
    };
    return WALK_RANGE_READY;
}
```

## src/walk_range_filter.h
```c
/* SPDX-License-Identifier: Apache-2.0 */
#ifndef WALK_RANGE_FILTER_H
#define WALK_RANGE_FILTER_H
#include <stdbool.h>
#include <stdint.h>

/* Stationary recovered drone + walking searcher. A configurable assumption,
 * NOT measured user speed or a correction of CS absolute-distance bias. */
#define WALK_RANGE_SPEED_MPS 2.0f
#define WALK_RANGE_WINDOW_GAP_MS 3000
#define WALK_RANGE_MAX_AGE_MS 1500

struct walk_range_filter {
    float samples[3];
    float metres;
    int64_t last_sample_ms, output_sample_ms, output_wall_ms;
    uint8_t count, next;
    bool seen_sample, have_output;
};
enum walk_range_state { WALK_RANGE_INVALID, WALK_RANGE_WARMING, WALK_RANGE_READY };
struct walk_range_output {
    float metres, median_metres, limit_metres;
    bool limited;
};
void walk_range_reset(struct walk_range_filter *filter);
/* Single owner (main thread). sample_ms is captured when a valid CS estimate
 * is produced; now_ms is the UI service time. Repeated/out-of-order, invalid,
 * future and stale samples do not mutate state. Three fresh samples warm up.
 * After a gap, discard the median window but retain the same-peer anchor.
 * Rate bound uses the smaller of elapsed observation and display time, so a
 * queued burst cannot consume multiple seconds of movement instantly. */
enum walk_range_state walk_range_update(struct walk_range_filter *filter,
        float raw_metres, int64_t sample_ms, int64_t now_ms,
        struct walk_range_output *output);
#endif
```
